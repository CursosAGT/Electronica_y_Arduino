/*             +  -                 +  -
               *  *    *  *  *  *  *       *  *  *  *  *    *  *
               *  *    *  *  *  *  *       *  *  +-----+    *  *
               *  * +----[PWR]-------------------| USB |--+ *  *
               *  * |                            +-----+  | *  *
               *  * |         GND/RST2  [ ][ ]            | *  *
               *  * |       MOSI2/SCK2  [ ][ ]  A5/SCL[ ] | *  *
               *  * |          5V/MISO2 [ ][ ]  A4/SDA[ ] | *  *
               *  * |                             AREF[ ] | *  *
               *  * |                              GND[ ] | *  *
               *  * | [ ]N/C                    SCK/13[ ] | *  *
               *  * | [ ]IOREF                 MISO/12[ ] | *  *
               *  * | [ ]RST                   MOSI/11[0]~|----------------------\
               *  * | [ ]3V3    +---+               10[0]~|---------------------\|
               0------[0]5v    -| A |-               9[0]~| -------------------\||
               *  * | [ ]GND   -| R |-               8[ ] | *  *               |||
               *  0---[0]GND   -| D |-                    | *  *               |||
               *  * | [ ]Vin   -| U |-               7[ ] | *  *               |||
               *  * |          -| I |-               6[ ]~| *  *               |||
               *  * | [ ]A0    -| N |-               5[ ]~| *  *               |||
               *  * | [ ]A1    -| O |-               4[ ] | *  *               |||
               *  * | [ ]A2     +---+           INT1/3[ ]~| *  *               |||
               *  * | [ ]A3                     INT0/2[ ] | *  *               |||
               *  * | [ ]A4/SDA   RST SCK MISO    TX>1[ ] | *  *               |||
               *  * | [ ]A5/SCL   [ ] [ ] [ ]     RX<0[ ] | *  *               |||
               *  * |             [ ] [ ] [ ]             | *  *               |||
               *  * |  UNO_R3     GND MOSI 5V ____________/ *  *               |||
               *  * \________________________/              *  *               |||
																			   |||
               *  *    *  *  *  *  *       *  *  *  *  *    *  *               |||
                  220 Ohm            Led 1              /---------------------/ || pin 9
               *  0-ww-0  *  *  *  0--|>|--0  *  *  *  0    *  *                ||
																				||
               *  *    *  *  *  *  *       *  *  *  *  *    *  *                ||
                  220 Ohm            Led 2              /----------------------/ | pin 10
               *  0-ww-0  *  *  *  0--|>|--0  *  *  *  0    *  *                 |
																				 |
               *  *    *  *  *  *  *       *  *  *  *  *    *  *                 |
                  220 Ohm            Led 3              /-----------------------/  pin 11
               *  0-ww-0  *  *  *  0--|>|--0  *  *  *  0    *  *

               *  *    *  *  *  *  *       *  *  *  *  *    *  *

               *  *    *  *  *  *  *       *  *  *  *  *    *  *

               *  0    *  *  *  *  *       *  *  *  *  *    *  0
 pin GND---------/ \------------------------------------------/ - GND
               *  *    *  *  *  *  *       *  *  *  *  *    *  *

               0  *    *  *  *  *  *       *  *  *  *  *    0  *
 pin 5v-------/ \------------------------------------------/+ 5v

*/
int leds[]={9,10,11};
int demora =  500;
int pin =  0;
int contador = 0;
void setup() {
  for (pin=0;pin<=2; pin++)
  {
    pinMode(leds[pin],OUTPUT);
  }
  Serial.begin(9600);
}
void loop()
{
  for (contador = 0; contador <=255; contador=contador+10)
  {
    for (pin=0;pin<=2; pin++)
    {
      analogWrite (leds[pin],contador);
      Serial.print("(leds[pin])");
      Serial.println(leds[pin]);
      Serial.print("(contador)");
      Serial.println(contador);
    }
  }
  delay(demora);
  contador = 0;
}


